/*
 * Copyright (c) 2016-2017, The Linux Foundation. All rights reserved.
 * Copyright (C) 2018 XiaoMi, Inc.
 *
 * This program is free software; you can redistribute it and/or modify
 * it under the terms of the GNU General Public License version 2 and
 * only version 2 as published by the Free Software Foundation.
 *
 * This program is distributed in the hope that it will be useful,
 * but WITHOUT ANY WARRANTY; without even the implied warranty of
 * MERCHANTABILITY or FITNESS FOR A PARTICULAR PURPOSE.  See the
 * GNU General Public License for more details.
*/

&soc {
	i2c_3: i2c@c177000 { /* BLSP1 QUP3 */
		clock-frequency = <400000>;
	};
	spi_7: spi@c1b7000 { /* BLSP2 QUP3 */
		status = "okay";

                device@1 {
                        compatible = "qcom,spi-msm-codec-slave";
                        #address-cells = <1>;
                        #size-cells = <1>;
                        reg = <1>; /* Chip select 0 */
                        spi-max-frequency = <1000000>;
                        spi-cpol;
                };
	};
};